## config/west.yml
```yaml
manifest:
  remotes:
    - name: zmkfirmware
      url-base: https://github.com/zmkfirmware
  projects:
    - name: zmk
      remote: zmkfirmware
      revision: v0.3.0  # zmk-revision (managed by `make ZMK_REV=...`)
      import: app/west.yml
  self:
    path: config
```

## hwmv2/boards/mriya/Kconfig.defconfig
```kconfig
# Copyright (c) 2023 Andrei Gaevskii
# SPDX-License-Identifier: MIT

if BOARD_MRIYA_LEFT

config ZMK_SPLIT_ROLE_CENTRAL
	default y

endif # BOARD_MRIYA_LEFT

if BOARD_MRIYA_LEFT || BOARD_MRIYA_RIGHT

config BOARD
	default "mriya"

config ZMK_SPLIT
	default y

config BT_CTLR
	default BT

config ZMK_BATTERY_VOLTAGE_DIVIDER
	default y

if USB

config USB_NRFX
	default y

config USB_DEVICE_STACK
	default y

endif # USB

endif # BOARD_MRIYA_LEFT || BOARD_MRIYA_RIGHT
```

## hwmv2/boards/mriya/Kconfig.mriya_left
```kconfig
# Copyright (c) 2023 Andrei Gaevskii
# SPDX-License-Identifier: MIT

config BOARD_MRIYA_LEFT
	select SOC_NRF52840_QIAA
	select ZMK_BOARD_COMPAT
	imply RETAINED_MEM
	imply RETENTION
	imply RETENTION_BOOT_MODE
```

## hwmv2/boards/mriya/board.yml
```yaml
boards:
  - name: mriya_left
    vendor: others
    socs:
      - name: nrf52840
  - name: mriya_right
    vendor: others
    socs:
      - name: nrf52840
```
